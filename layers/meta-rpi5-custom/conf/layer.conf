## layers/meta-rpi5-custom/conf/layer.conf
```bitbake
BBPATH .= ":${LAYERDIR}"
BBFILES += "${LAYERDIR}/recipes-*/*/*.bb ${LAYERDIR}/recipes-*/*/*.bbappend"
BBFILE_COLLECTIONS += "rpi5-custom"
BBFILE_PATTERN_rpi5-custom = "^${LAYERDIR}/"
BBFILE_PRIORITY_rpi5-custom = "10"
LAYERDEPENDS_rpi5-custom = "core raspberrypi"
LAYERSERIES_COMPAT_rpi5-custom = "scarthgap"
```
